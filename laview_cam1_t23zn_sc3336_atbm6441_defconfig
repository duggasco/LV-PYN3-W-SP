## laview_cam1_t23zn_sc3336_atbm6441_defconfig
```kconfig
BR2_mipsel=y
BR2_mips_xburst=y
# BR2_MIPS_SOFT_FLOAT is not set
BR2_MIPS_FP32_MODE_32=y
BR2_TOOLCHAIN_EXTERNAL=y
BR2_TOOLCHAIN_EXTERNAL_CUSTOM=y
BR2_TOOLCHAIN_EXTERNAL_DOWNLOAD=y
BR2_TOOLCHAIN_EXTERNAL_URL="https://github.com/themactep/thingino-firmware/releases/download/toolchain-$(BR2_HOSTARCH)/thingino-toolchain-$(BR2_HOSTARCH)_$(INGENIC_ARCH)_musl_gcc14-linux-mipsel.tar.gz"
BR2_TOOLCHAIN_EXTERNAL_HEADERS_3_10=y
BR2_TOOLCHAIN_EXTERNAL_CUSTOM_MUSL=y
BR2_TOOLCHAIN_EXTERNAL_CXX=y
BR2_TARGET_LDFLAGS="-z max-page-size=0x1000"
BR2_CCACHE=y
BR2_CCACHE_DIR="$(HOME)/.ccache"
BR2_STRIP_EXCLUDE_FILES="libimp.so libalog.so"
BR2_OPTIMIZE_S=y
BR2_GLOBAL_PATCH_DIR="$(BR2_EXTERNAL)/package/all-patches"
BR2_REPRODUCIBLE=y
BR2_PER_PACKAGE_DIRECTORIES=y
BR2_TARGET_GENERIC_HOSTNAME="thingino-$(SOC_MODEL)"
BR2_TARGET_GENERIC_ISSUE="Welcome to Thingino firmware"
BR2_TARGET_GENERIC_PASSWD_SHA512=y
BR2_ROOTFS_MERGED_USR=y
BR2_TARGET_GENERIC_ROOT_PASSWD="root"
BR2_SYSTEM_DEFAULT_PATH="/bin:/sbin:/usr/bin:/usr/sbin"
BR2_ROOTFS_OVERLAY="$(BR2_EXTERNAL)/overlay/lower"
BR2_ROOTFS_POST_BUILD_SCRIPT="$(BR2_EXTERNAL)/scripts/rootfs_script.sh"
BR2_LINUX_KERNEL_CUSTOM_GIT=y
BR2_LINUX_KERNEL_CUSTOM_REPO_URL="$(KERNEL_SITE)"
BR2_LINUX_KERNEL_CUSTOM_REPO_VERSION="$(KERNEL_HASH)"
BR2_LINUX_KERNEL_USE_CUSTOM_CONFIG=y
BR2_LINUX_KERNEL_CUSTOM_CONFIG_FILE="$(BR2_EXTERNAL)/board/ingenic/$(INGENIC_ARCH)/kernel/$(KERNEL_VERSION)/$(SOC_FAMILY).generic.config"
BR2_LINUX_KERNEL_LZMA=y
BR2_PACKAGE_BUSYBOX_CONFIG="$(BR2_EXTERNAL)/package/busybox/busybox.config"
BR2_PACKAGE_MDNSD=y
BR2_PACKAGE_MDNSD_HTTP_SERVICE=y
# BR2_PACKAGE_MDNSD_SSH_SERVICE is not set
BR2_PACKAGE_ODHCP6C=y
BR2_PACKAGE_WIREGUARD_LINUX_COMPAT=y
BR2_PACKAGE_WIREGUARD_TOOLS=y
BR2_TARGET_ROOTFS_SQUASHFS=y
BR2_TARGET_ROOTFS_SQUASHFS4_XZ=y
BR2_TARGET_ROOTFS_SQUASHFS_EXTREME_COMP=y
BR2_PACKAGE_HOST_MTD=y
BR2_THINGINO_AUDIO=y
BR2_THINGINO_PWM_ENABLE=y
BR2_THINGINO_SDCARD=y
BR2_THINGINO_BUTTON=y
BR2_SENSOR_SC3336=y
BR2_PACKAGE_WIFI=y
BR2_PACKAGE_THINGINO_KOPT_MMC0=y
BR2_PACKAGE_THINGINO_DIAG=y
BR2_PACKAGE_THINGINO_GPIO=y
BR2_PACKAGE_THINGINO_LEDD=y
BR2_PACKAGE_THINGINO_SYSTEM=y
BR2_PACKAGE_THINGINO_SYSUPGRADE=y
BR2_PACKAGE_THINGINO_UBOOT_BOARDNAME="$(UBOOT_BOARDNAME)"
BR2_PACKAGE_THINGINO_UBOOT_CUSTOM_GIT=y
BR2_PACKAGE_THINGINO_UBOOT_CUSTOM_REPO_URL="$(UBOOT_REPO)"
BR2_PACKAGE_THINGINO_UBOOT_CUSTOM_REPO_VERSION="$(UBOOT_REPO_VERSION)"
BR2_PACKAGE_THINGINO_UBOOT_NEEDS_LZOP=y
# BR2_PACKAGE_THINGINO_UBOOT_FORMAT_BIN is not set
BR2_PACKAGE_THINGINO_UBOOT_FORMAT_CUSTOM=y
BR2_PACKAGE_THINGINO_UBOOT_FORMAT_CUSTOM_NAME="u-boot-lzo-with-spl.bin"
BR2_PACKAGE_THINGINO_UBOOT_EXTERNAL_ENV_ENABLE=y
BR2_PACKAGE_THINGINO_UBOOT_CUSTOM_MAKEOPTS="-j1"
BR2_PACKAGE_THINGINO_UBOOT_ROOT="/dev/mtdblock4"
BR2_PACKAGE_THINGINO_UBOOT_ROOTFSTYPE="squashfs"
BR2_PACKAGE_THINGINO_UBOOT_INIT="/init"
BR2_PACKAGE_THINGINO_UBOOT_MTDPARTS="setenv mtdparts mtdparts=$(UBOOT_FLASH_CONTROLLER):256k(boot),32k(env),224k(config),${kern_size_dec}(kernel),${rootfs_size}(rootfs),-(rootfs_data)${update}"
BR2_PACKAGE_THINGINO_UBOOT_BOOTARGS="setenv bootargs mem=${osmem} rmem=${rmem}$(UBOOT_ISPMEM)$(UBOOT_NMEM)console=${serialport},${baudrate}n8 panic=${panic_timeout} root=${root} rootfstype=${rootfstype} init=${init} \\${mtdparts}"
BR2_PACKAGE_THINGINO_UBOOT_BOOTCMD="sf probe-alt;sq probe-alt;run mtdparts;run bootargs;sf read ${baseaddr} ${kern_addr} ${kern_size};bootm ${baseaddr}"
BR2_PACKAGE_PRUDYNT_T=y
BR2_PACKAGE_PRUDYNT_T_NG=y
BR2_PACKAGE_THINGINO_MOSQUITTO=y
```

## t23zn_sc3336_atbm6441_defconfig
```kconfig
# NAME: T23Z, SC3336, ATBM6441
# FRAG: soc toolchain ccache brand rootfs kernel system target uboot
BR2_SOC_INGENIC_T23Z=y
BR2_SENSOR_SC3336=y
BR2_PACKAGE_WIFI=y
BR2_PACKAGE_WIFI_ATBM6441=y
```
